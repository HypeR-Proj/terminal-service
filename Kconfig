## Kconfig
```kconfig
# SPDX-FileCopyrightText: 2026 roolrz
# SPDX-License-Identifier: Apache-2.0

config SYSTEM_APP_TERMINAL_SERVICE
    bool "terminal-service (/svc/terminal-service)"
    default y
    depends on SYSTEM_APP_CONSOLE_RAW_SYSTEM
    help
        Build and deploy hyper-terminal-service at /svc/terminal-service.
```
